## Documentation/devicetree/bindings/media/microchip,generic-video-pipeline-connector.yaml
```yaml
# SPDX-License-Identifier: (GPL-2.0-only OR BSD-2-Clause)
%YAML 1.2
---
$id: http://devicetree.org/schemas/media/microchip,generic-video-pipeline-connector.yaml#
$schema: http://devicetree.org/meta-schemas/core.yaml#

title: Microchip Generic Video Pipeline Connector (GVPC)

maintainers:
  - Shravan Chippa <shravan.chippa@microchip.com>

description: |
  The Microchip generic video pipeline connector is used for the FPGA
  logic to convert the video format and stream the data through
  AXI streaming or negative interface for the image processing.

properties:
  compatible:
    const: microchip,generic-video-pipeline-connector

  reg:
    maxItems: 1

  ports:
    $ref: /schemas/graph.yaml#/properties/ports

    properties:
      "#address-cells":
        const: 1

      "#size-cells":
        const: 0

      port@0:
        type: object
        description: Input/sink port node to receive the video data.

        properties:
          reg:
            description: Input/sink port number.
            const: 0

          microchip,video-format:
            description: Output/source video format. Possible values are as below.
              0 - MVCF_MONO_SENSOR
              1 - MVCF_YUV_444
              2 - MVCF_YUV_422
              3 - MVCF_YUV_420
              4 - MVCF_RBG
              5 - MVCF_H264
              6 - MVCF_MJPEG
              7 - MVCF_RGB
            $ref: /schemas/types.yaml#/definitions/uint32
            enum: [0, 1, 2, 3, 4, 5, 6, 7]

          microchip,cfa-pattern:
            description: Output/source video pattern.
            $ref: /schemas/types.yaml#/definitions/string
            enum:
              - mono
              - rggb
              - bggr
              - gbrg
              - grbg
            default: mono

          microchip,video-width:
            description: Output/source video axi stream width.
            $ref: /schemas/types.yaml#/definitions/uint32
            enum: [8, 10, 12, 16, 20, 32]

          endpoint:
            type: object

            properties:
              remote-endpoint: true

            required:
              - remote-endpoint

            additionalProperties: false

        required:
          - reg
          - endpoint
          - microchip,video-format
          - microchip,video-width
        allOf:
          - if:
              properties:
                microchip,video-format:
                  contains:
                    const: 0
            then:
              required:
                - microchip,cfa-pattern

        additionalProperties: false

    patternProperties:
      "port@1":
        type: object
        description: Output/source port node to transmit the video data.
        properties:
          reg:
            description: Output/source port number.

          microchip,video-format:
            description:
              Output/source video format.
              Possible values are as below -
              0 - MVCF_MONO_SENSOR
              1 - MVCF_YUV_444
              2 - MVCF_YUV_422
              3 - MVCF_YUV_420
              4 - MVCF_RBG
              5 - MVCF_H264
              6 - MVCF_MJPEG
              7 - MVCF_RGB
            $ref: /schemas/types.yaml#/definitions/uint32
            enum: [0, 1, 2, 3, 4, 5, 6, 7]

          microchip,cfa-pattern:
            description: Output/source video pattern.
            $ref: /schemas/types.yaml#/definitions/string
            enum:
              - mono
              - rggb
              - bggr
              - gbrg
              - grbg
            default: mono

          microchip,video-width:
            description: Output/source video axi stream width.
            $ref: /schemas/types.yaml#/definitions/uint32
            enum: [8, 10, 12, 16, 20, 32]

          endpoint:
            type: object

            properties:
              remote-endpoint: true

            required:
              - remote-endpoint

            additionalProperties: false

        required:
          - reg
          - endpoint
          - microchip,video-format
          - microchip,video-width
        allOf:
          - if:
              properties:
                microchip,video-format:
                  contains:
                    const: 0
            then:
              required:
                - microchip,cfa-pattern

        additionalProperties: false

    required:
      - "#address-cells"
      - "#size-cells"
      - port@0
      - port@1

    additionalProperties: false

required:
  - compatible
  - reg
  - ports

additionalProperties: false

examples:
  - |
    #include <dt-bindings/media/microchip-common.h>

    mgvpc_0: gvpc-video-0@50020000 {
        compatible = "microchip,generic-video-pipeline-connector";
        reg = <0x50020000 0x10000>;

        ports {
            #address-cells = <1>;
            #size-cells = <0>;

            port@0 {
                /* Sink port */
                reg = <0>;
                microchip,video-format = <MVCF_MONO_SENSOR>;
                microchip,cfa-pattern = "rggb";
                microchip,video-width = <8>;
                gvpc_0_in: endpoint {
                    remote-endpoint = <&mipi_csi2_0_out>;
                };
            };
            port@1 {
                /* Source port */
                reg = <1>;
                microchip,video-format = <MVCF_YUV_420>;
                microchip,video-width = <8>;
                gvpc_0_out: endpoint {
                    remote-endpoint = <&h264_in>;
                };
            };
        };
    };
...
```

## Documentation/devicetree/bindings/media/microchip,mipi-csi2rx.yaml
```yaml
# SPDX-License-Identifier: (GPL-2.0-only OR BSD-2-Clause)
%YAML 1.2
---
$id: http://devicetree.org/schemas/media/microchip,mipi-csi2rx.yaml#
$schema: http://devicetree.org/meta-schemas/core.yaml#

title: Microchip MIPI CSI-2 Receiver Subsystem

maintainers:
  - Shravan Chiappa  <shravan.chippa@microchip.com>

description:
  The Microchip MIPI CSI-2 Receiver Subsystem is used to capture MIPI CSI-2
  traffic from compliant camera sensors and send the output as AXI4 Stream
  video data for image processing.
  The subsystem consists of a MIPI D-PHY in slave mode which captures the
  data packets. This is passed along the MIPI CSI-2 Rx IP which extracts the
  packet data.

properties:
  compatible:
    items:
      - enum:
          - microchip,mipi-csi2-rx-rtl-v0

  reg:
    maxItems: 1

  interrupts:
    maxItems: 1

  clocks:
    items:
      - description: AXI Lite clock
      - description: Video frame clock

  clock-names:
    items:
      - const: axi
      - const: video

  microchip,csi-pxl-format:
    description: |
      This denotes the CSI Data type selected in hw design.
      Possible values are as below -
      0x24 - RGB888
      0x2a - RAW8
      0x2b - RAW10
      0x2c - RAW12
      0x2d - RAW14
      0x2e - RAW16
    $ref: /schemas/types.yaml#/definitions/uint32
    enum: [0x24, 0x2a, 0x2b, 0x2c, 0x2d, 0x2e]
    default: 0x2a

  microchip,csi-fixed-out-raw8:
    type: boolean
    description: Present when Video Format output is raw8 fixed

  ports:
    $ref: /schemas/graph.yaml#/properties/ports

    properties:
      port@0:
        $ref: /schemas/graph.yaml#/$defs/port-base
        description: |
          Input / sink port node, single endpoint describing the
          CSI-2 transmitter.

        properties:
          endpoint:
            $ref: /schemas/media/video-interfaces.yaml#
            unevaluatedProperties: false

            properties:
              data-lanes:
                description: |
                  This is required only in the sink port 0 endpoint which
                  connects to MIPI CSI-2 source like sensor.
                  The possible values are -
                  1       - For 1 lane enabled in IP.
                  1 2     - For 2 lanes enabled in IP.
                  1 2 3   - For 3 lanes enabled in IP.
                  1 2 3 4 - For 4 lanes enabled in IP.
                items:
                  - const: 1
                  - const: 2
                  - const: 3
                  - const: 4

            required:
              - data-lanes

        unevaluatedProperties: false

      port@1:
        $ref: /schemas/graph.yaml#/properties/port
        description: |
          Output / source port node, endpoint describing modules
          connected the CSI-2 receiver.

required:
  - compatible
  - reg
  - interrupts
  - clocks
  - clock-names
  - microchip,csi-pxl-format
  - ports

additionalProperties: false

examples:
  - |
    mcsi2rx_0: csi2rx@50020000 {
        compatible = "microchip,mipi-csi2-rx";
        reg = <0x50020000 0x10000>;
        interrupt-parent = <&plic>;
        interrupts = <120>;
        microchip,csi-pxl-format = <0x2a>;
        clock-names = "axi", "video";
        clocks = <&axi_clk_0>, <&video_clk_0>;
        status = "okay";

        ports {
            #address-cells = <1>;
            #size-cells = <0>;

            port@0 {
                /* Sink port */
                reg = <0>;
                csi_0_in: endpoint {
                    data-lanes = <1 2 3 4>;
                    /* MIPI CSI-2 Camera handle */
                    remote-endpoint = <&camera_out>;
                };
            };
            port@1 {
                /* Source port */
                reg = <1>;
                csi_0_out: endpoint {
                    remote-endpoint = <&vproc_in>;
                };
            };
        };
    };
...
```

## Documentation/devicetree/bindings/media/microchip,osd.yaml
```yaml
# SPDX-License-Identifier: (GPL-2.0-only OR BSD-2-Clause)
%YAML 1.2
---
$id: http://devicetree.org/schemas/media/microchip,osd.yaml#
$schema: http://devicetree.org/meta-schemas/core.yaml#

title: Microchip Video On Screen Display (OSD)

maintainers:
  - Shravan Chippa <shravan.chippa@microchip.com>

description: |
  The Microchip video on screen display is a user-defined FPGA
  logic to display text on the video frames and stream the video
  data through the native interface for image processing.

properties:
  compatible:
    enum:
      - microchip,osd-rtl-v1

  reg:
    maxItems: 1

  ports:
    $ref: /schemas/graph.yaml#/properties/ports

    properties:
      "#address-cells":
        const: 1

      "#size-cells":
        const: 0

      port@0:
        type: object
        description: The Input/sink port node properties.
        properties:
          reg:
            description: Input/sink port number.
            const: 0

          endpoint:
            type: object

            properties:
              remote-endpoint: true

            required:
              - remote-endpoint

            additionalProperties: false

        required:
          - reg
          - endpoint

        additionalProperties: false

    patternProperties:
      "port@1":
        type: object
        description: The Output/source port node properties.
        properties:
          reg:
            description: Output/source port number.

          endpoint:
            type: object

            properties:
              remote-endpoint: true

            required:
              - remote-endpoint

            additionalProperties: false

        required:
          - reg
          - endpoint

        additionalProperties: false

    required:
      - "#address-cells"
      - "#size-cells"
      - port@0
      - port@1

    additionalProperties: false

required:
  - compatible
  - reg
  - ports

additionalProperties: false

examples:
  - |
    #include <dt-bindings/media/microchip-common.h>
    osd-0@50020000 {
        compatible = "microchip,osd-rtl-v1";
        reg = <0x50020000 0x10000>;

        ports {
            #address-cells = <1>;
            #size-cells = <0>;

            port@0 {
                /* Sink port */
                reg = <0>;
                osd_0_in: endpoint {
                    remote-endpoint = <&monotorgb_0_out>;
                };
            };
            port@1 {
                /* Source port */
                reg = <1>;
                osd_0_out: endpoint {
                    remote-endpoint = <&rgb_scaler_0_in>;
                };
            };
        };
    };
...
```

## Documentation/devicetree/bindings/media/microchip,rgb-scaler.yaml
```yaml
# SPDX-License-Identifier: (GPL-2.0-only OR BSD-2-Clause)
%YAML 1.2
---
$id: http://devicetree.org/schemas/media/microchip,rgb-scaler.yaml#
$schema: http://devicetree.org/meta-schemas/core.yaml#

title: Microchip rgb scaler

maintainers:
  - Shravan Chippa <shravan.chippa@microchip.com>

description: |
  The Microchip video rgb scaler IP is used to scale up/down the
  video image and stream the video data through AXI streaming
  interface or native interface for the image processing.

properties:
  compatible:
    enum:
      - microchip,rgb-scaler-rtl-v1

  reg:
    maxItems: 1

  ports:
    $ref: /schemas/graph.yaml#/properties/ports

    properties:
      "#address-cells":
        const: 1

      "#size-cells":
        const: 0

      port@0:
        type: object
        description: The Input/sink port node properties.
        properties:
          reg:
            description: Input/sink port number.
            const: 0

          endpoint:
            type: object

            properties:
              remote-endpoint: true

            required:
              - remote-endpoint

            additionalProperties: false

        required:
          - reg
          - endpoint

        additionalProperties: false

    patternProperties:
      "port@1":
        type: object
        description: The Output/source port node properties.
        properties:
          reg:
            description: Output/source port number.

          endpoint:
            type: object

            properties:
              remote-endpoint: true

            required:
              - remote-endpoint

            additionalProperties: false

        required:
          - reg
          - endpoint

        additionalProperties: false

    required:
      - "#address-cells"
      - "#size-cells"
      - port@0
      - port@1

    additionalProperties: false

required:
  - compatible
  - reg
  - ports

additionalProperties: false

examples:
  - |
    #include <dt-bindings/media/microchip-common.h>
    rgb-scaler-0@50020000 {
        compatible = "microchip,rgb-scaler-rtl-v1";
        reg = <0x50020000 0x10000>;

        ports {
            #address-cells = <1>;
            #size-cells = <0>;

            port@0 {
                /* Sink port */
                reg = <0>;
                gvpc_0_in: endpoint {
                    remote-endpoint = <&image_enhancement_0_out>;
                };
            };
            port@1 {
                /* Source port */
                reg = <1>;
                gvpc_0_out: endpoint {
                    remote-endpoint = <&osd_0_in>;
                };
            };
        };
    };
...
```
