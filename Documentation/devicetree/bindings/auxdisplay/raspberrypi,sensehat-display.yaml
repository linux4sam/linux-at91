## Documentation/devicetree/bindings/remoteproc/microchip,miv-remoteproc.yaml
```yaml
# SPDX-License-Identifier: (GPL-2.0-only OR BSD-2-Clause)
%YAML 1.2
---
$id: http://devicetree.org/schemas/remoteproc/microchip,miv-remoteproc.yaml#
$schema: http://devicetree.org/meta-schemas/core.yaml#

title: Microchip Mi-V Remoteproc

description:
  Microchip's SoCs using the Mi-V ecosystem typically have one or more
  harts (cores) within a coreplex. This coreplex can be configured to run in
  an Asymmetric Multi Processing (AMP) mode where harts (cores) are split in
  independent software contexts.

  This document defines the binding for the remoteproc component that loads and
  boots firmwares on the remote AMP context.

maintainers:
  - Valentina Fernandez <valentina.fernandezalanis@microchip.com>
  - Conor Dooley <conor.dooley@microchip.com>

properties:
  compatible:
    const: microchip,miv-remoteproc

  mboxes:
    description:
      This property is required only if the rpmsg/virtio functionality is used.
      Mi-V IHC mailbox specifier. To be used for communication with a
      remote AMP context. The specifier format is as per the bindings,
      Documentation/devicetree/bindings/mailbox/microchip,miv-ihc.yaml
    minItems: 1

  microchip,auto-boot:
    $ref: /schemas/types.yaml#/definitions/flag
    description:
      If defined, when remoteproc is probed, it loads the default firmware and
      starts the remote processor.

allOf:
  - $ref: /schemas/reserved-memory/memory-region.yaml

required:
  - compatible

unevaluatedProperties: false

examples:
  - |

    reserved-memory {
        #address-cells = <1>;
        #size-cells = <1>;

        contextb: contextb_reserved@81000000 {
          reg = <0x81000000 0x400000>;
          no-map;
        };
    };

    soc {
      #address-cells = <2>;
      #size-cells = <2>;

      remote-context {
          compatible = "microchip,miv-remoteproc";
          memory-region = <&contextb>;
          mboxes= <&ihc 0>;
      };
    };

...
```

## Documentation/devicetree/bindings/sound/microchip,asrc-card.yaml
```yaml
# SPDX-License-Identifier: (GPL-2.0 OR BSD-2-Clause)
%YAML 1.2
---
$id: http://devicetree.org/schemas/sound/microchip,asrc-card.yaml#
$schema: http://devicetree.org/meta-schemas/core.yaml#

title: Sound Card driver for Microchip's Asynchronous Sample Rate Converter

maintainers:
  - Codrin Ciubotariu <codrin.ciubotariu@microchip.com>

description:
  Sound Card driver to be used with Microchip's ASRC. It is able to register
  the ASRC as Front-End and makes the rest of the audio IPs behave as
  Back-ends and as normal PCMs as well. The ASRC use is optional though.

definitions:
  model:
    description: User specified audio sound card name.
    $ref: /schemas/types.yaml#/definitions/string

  audio-routing:
    description: |
      A list of the connections between audio components.
      Each entry is a pair of strings, the first being the
      connection's sink, the second being the connection's source.
    $ref: /schemas/types.yaml#/definitions/non-unique-string-array

  dai-tdm-slot-num:
    description: see tdm-slot.txt.
    $ref: /schemas/types.yaml#/definitions/uint32

  dai-tdm-slot-width:
    description: see tdm-slot.txt.
    $ref: /schemas/types.yaml#/definitions/uint32

  frame-master:
    description: Indicates dai-link frame master.
    $ref: /schemas/types.yaml#/definitions/phandle

  bitclock-master:
    description: Indicates dai-link bit clock master
    $ref: /schemas/types.yaml#/definitions/phandle

  label:
    maxItems: 1

  format:
    description: audio format.
    items:
      enum:
        - i2s
        - right_j
        - left_j
        - dsp_a
        - dsp_b
        - pdm

  convert-rate:
    description: Front-End to Back-End rate convert.
    $ref: /schemas/types.yaml#/definitions/uint32

  convert-channels:
    description: Front-end to Back-end channels convert.
    $ref: /schemas/types.yaml#/definitions/uint32

  convert-sample-format:
    description: Front-end to Back-end sample format convert.
    $ref: /schemas/types.yaml#/definitions/uint32

  dai:
    type: object
    properties:
      sound-dai:
        maxItems: 1

      # common properties
      frame-master:
        $ref: /schemas/types.yaml#/definitions/flag
      bitclock-master:
        $ref: /schemas/types.yaml#/definitions/flag
      dai-tdm-slot-num:
        $ref: "#/definitions/dai-tdm-slot-num"
      dai-tdm-slot-width:
        $ref: "#/definitions/dai-tdm-slot-width"
    required:
      - sound-dai
properties:
  compatible:
    const: microchip,sama7g5-asrc-card

  "#address-cells":
    const: 1
  "#size-cells":
    const: 0

  label:
    $ref: "#/definitions/label"

patternProperties:
  "^microchip,dai-link(@[0-9a-f]+)?$":
    description: |
      Container for dai-link level properties and the CPU and CODEC sub-nodes.
      This container may be omitted when the card has only one DAI link.
    type: object
    properties:

      # common properties
      microchip,frame-master:
        $ref: "#/definitions/frame-master"
      microchip,bitclock-master:
        $ref: "#/definitions/bitclock-master"
      microchip,format:
        $ref: "#/definitions/format"
      microchip,convert-rate:
        $ref: "#/definitions/convert-rate"
      microchip,convert-channels:
        $ref: "#/definitions/convert-channels"
      microchip,convert-sample-format:
        $ref: "#/definitions/convert-sample-format"

    patternProperties:
      "^cpu(@[0-9a-f]+)?":
        $ref: "#/definitions/dai"
      "^codec(@[0-9a-f]+)?":
        $ref: "#/definitions/dai"
    additionalProperties: false

required:
  - compatible
  - microchip,model

additionalProperties: false

examples:
  - |
    #include <dt-bindings/sound/microchip,asrc-card.h>

    sound: sound {
        #address-cells = <1>;
        #size-cells = <0>;
        compatible = "microchip,asrc-card";
        microchip,model = "mchp-asrc-card @ sama5g7 EK";

        microchip,audio-asrc = <&asrc 0>, <&asrc 1>, <&asrc 2>, <&asrc 3>;

        microchip,dai-link@0 {
            reg = <0>;
            microchip,format = "i2s";
            microchip,frame-master = <&dailink_master>;
            microchip,bitclock-master = <&dailink_master>;
            microchip,convert-channels = <2>;
            microchip,convert-rate = <48000>;
            microchip,convert-sample-format = <MCHP_ASRC_PCM_FORMAT_S24_LE>;
            dailink_master: cpu {
                sound-dai = <&i2s0>;
            };
            codec {
                sound-dai = <&wm8731>;
            };
        };
    };
```

## drivers/gpu/drm/microchip/Kconfig
```kconfig
# SPDX-License-Identifier: GPL-2.0-only
config DRM_MICROCHIP_GFX2D
	tristate "DRM support for Microchip GFX2D GPU"
	depends on DRM && OF && COMMON_CLK && ARM
	help
	  Choose this option if you have a Microchip SoC with a GFX2D GPU
	  (i.e. SAM9X60 or SAM9X7 families). The GFX2D supports basic 2D
	  graphics instructions, each working on a single rectangle defined
	  by its width and height plus the coordinates of its top-left
	  corner in each of the surface (behind a DRM GEM object) involved
	  in the graphics instructions. There are four types of graphics
	  instructions:
	  - FILL: the rectangle is filled in the target surface with a
	  uniform color.
	  - COPY: the rectangle is copied from a single source surface into
	  the target surface.
	  - BLEND: the rectangle in the target surface is the result of a
	  blending from rectangles of the same size in two source surfaces.
	  - ROP: the rectangle in the target surface is the result of a
	  raster operation on two (ROP2), three (ROP3), or four (ROP4)
	  source surfaces, depending on the selected raster mode.
```
