## Documentation/devicetree/bindings/auxdisplay/raspberrypi,sensehat-display.yaml
```yaml
# SPDX-License-Identifier: (GPL-2.0-only OR BSD-2-Clause)
%YAML 1.2
---
$id: http://devicetree.org/schemas/auxdisplay/raspberrypi,sensehat-display.yaml#
$schema: http://devicetree.org/meta-schemas/core.yaml#

title: Raspberry Pi Sensehat Display

maintainers:
  - Charles Mirabile <cmirabil@redhat.com>
  - Joel Savitz <jsavitz@redhat.com>

description:
  This device is part of the sensehat multi function device.
  For more information see ../mfd/raspberrypi,sensehat.yaml.

  This device features a programmable 8x8 RGB LED matrix.

properties:
  compatible:
    const: raspberrypi,sensehat-display

required:
  - compatible

additionalProperties: false
```

## Documentation/devicetree/bindings/crypto/microchip,mpfs-crypto.yaml
```yaml
# SPDX-License-Identifier: (GPL-2.0-only OR BSD-2-Clause)
%YAML 1.2
---
$id: http://devicetree.org/schemas/crypto/microchip,mpfs-crypto.yaml#
$schema: http://devicetree.org/meta-schemas/core.yaml#

title: Microchip PolarFire SoC (MPFS) MSS (microprocessor subsystem) User Crypto

maintainers:
  - Padmarao Begari <padmarao.begari@microchip.com>

properties:
  compatible:
    const: microchip,mpfs-crypto

  reg:
    maxItems: 1

  interrupts:
    maxItems: 1

  clocks:
    items:
      - description: AHB peripheral clock
      - description: Crypto clock

required:
  - compatible
  - reg
  - clocks
  - interrupts

additionalProperties: false

examples:
  - |
    #include "dt-bindings/clock/microchip,mpfs-clock.h"
    crypto@22000000 {
        compatible = "microchip,mpfs-crypto";
        reg = <0x22000000 0x10000>;
        clocks = <&clkcfg 0>, <&clkcfg 1>;
        interrupt-parent = <&plic>;
        interrupts = <112>;
    };
```

## Documentation/devicetree/bindings/display/bridge/microchip,sam9x75-mipi-dsi.yaml
```yaml
# SPDX-License-Identifier: (GPL-2.0-only OR BSD-2-Clause)
%YAML 1.2
---
$id: http://devicetree.org/schemas/display/bridge/microchip,sam9x75-mipi-dsi.yaml#
$schema: http://devicetree.org/meta-schemas/core.yaml#

title: Microchip SAM9X75 MIPI DSI Controller

maintainers:
  - Manikandan Muralidharan <manikandan.m@microchip.com>

description:
  Microchip specific extensions or wrapper to the Synopsys Designware MIPI DSI.
  The MIPI Display Serial Interface (DSI) Host Controller implements all
  protocol functions defined in the MIPI DSI Specification. The DSI Host
  provides an interface between the LCD Controller (LCDC) and the MIPI D-PHY,
  allowing communication with a DSI-compliant display.

allOf:
  - $ref: /schemas/display/dsi-controller.yaml#

properties:
  compatible:
    const: microchip,sam9x75-mipi-dsi

  reg:
    maxItems: 1

  clocks:
    description:
      MIPI DSI must have two clocks to function correctly.Peripheral clock
      'pclk' for the hardware block functionality and Generic clock 'refclk' to
      drive the D-PHY PLL block.
    minItems: 2

  clock-names:
    items:
      - const: pclk
      - const: refclk

  microchip,sfr:
    $ref: /schemas/types.yaml#/definitions/phandle
    description:
      phandle to Special Function Register (SFR) node.To enable the DSI/CSI
      selection bit in SFR's ISS Configuration Register.

  ports:
    $ref: /schemas/graph.yaml#/properties/ports

    properties:
      port@0:
        $ref: /schemas/graph.yaml#/$defs/port-base
        unevaluatedProperties: false
        description:
          DSI Input port node, connected to the LCDC RGB output port.

        properties:
          endpoint:
            $ref: /schemas/media/video-interfaces.yaml#
            unevaluatedProperties: false
            properties:
              remote-endpoint: true

      port@1:
        $ref: /schemas/graph.yaml#/$defs/port-base
        unevaluatedProperties: false
        description:
          DSI Output port node, connected to a panel or a bridge input port.

        properties:
          endpoint:
            $ref: /schemas/media/video-interfaces.yaml#
            unevaluatedProperties: false
            properties:
              remote-endpoint: true

required:
  - compatible
  - reg
  - clocks
  - clock-names
  - ports

unevaluatedProperties: false

examples:
  - |
    #include <dt-bindings/clock/at91.h>
    #include <dt-bindings/gpio/gpio.h>

    dsi: dsi@f8054000 {
         compatible = "microchip,sam9x75-mipi-dsi";
         reg = <0xf8054000 0x200>;
         clocks = <&pmc PMC_TYPE_PERIPHERAL 54>, <&pmc PMC_TYPE_GCK 55>;
         clock-names = "pclk", "refclk";
         microchip,sfr = <&sfr>;

         #address-cells = <1>;
         #size-cells = <0>;

         ports {
                #address-cells = <1>;
                #size-cells = <0>;

                port@0 {
                        reg = <0>;
                        dsi_in: endpoint {
                            remote-endpoint = <&hlcdc_panel_output>;
                        };
                };

                port@1 {
                        reg = <1>;
                        dsi_out: endpoint {
                            remote-endpoint = <&mipi_in_panel>;
                        };
                };
         };

         panel@0 {
              compatible = "hannstar,hsd060bhw4", "himax,hx8394";
              reg = <0>;
              vcc-supply = <&mic23150_reg>;
              iovcc-supply = <&mic23150_reg>;
              reset-gpios = <&pioC 24 GPIO_ACTIVE_LOW>;
              backlight = <&backlight>;

              port {
                   mipi_in_panel: endpoint {
                        remote-endpoint = <&dsi_out>;
                   };
              };
         };
    };

...
```

## Documentation/devicetree/bindings/display/panel/waveshare,dsi-touchscreen.yaml
```yaml
# SPDX-License-Identifier: GPL-2.0
%YAML 1.2
---
$id: http://devicetree.org/schemas/display/panel/waveshare,dsi-touchscreen.yaml#
$schema: http://devicetree.org/meta-schemas/core.yaml#

title: Waveshare DSI touchscreens

maintainers:
  - Dave Stevenson <dave.stevenson@raspberrypi.com>
  - eng33 <eng33@waveshare.com>

description: |+
  This DSI panel contains:
  - Waveshare DSI Panel used to drive dsi panels.
  - Touchscreen controller on I2C for touch input and this binding covers the
    DSI display parts but not its touch input.

properties:
  compatible:
    oneOf:
      - items:
          - const: waveshare,7.0inch-c-panel
          - const: waveshare,2.8inch-panel
          - const: waveshare,3.4inch-panel
          - const: waveshare,4.0inch-panel
          - const: waveshare,7.0inch-c-panel
          - const: waveshare,7.9inch-panel
          - const: waveshare,8.0inch-panel
          - const: waveshare,10.1inch-panel
          - const: waveshare,11.9inch-panel
          - const: waveshare,4inch-panel
          - const: waveshare,5.0inch-panel
          - const: waveshare,6.25inch-panel
          - const: waveshare,8.8inch-panel
          - const: waveshare,13.3inch-4lane-panel
          - const: waveshare,13.3inch-2lane-panel
      - enum:
          - waveshare,7.0inch-c-panel

  reg:
    const: 0x45

  port: true

required:
  - compatible
  - reg
  - port

additionalProperties: false

examples:
  - |+
    dsi {
        status = "okay";
        #address-cells = <1>;
        #size-cells = <0>;

        ports {
            #address-cells = <1>;
            #size-cells = <0>;

            port@0 {
                reg = <0>;
                dsi_in: endpoint {
                remote-endpoint = <&xlcdc_out>;
                };
            };

            port@1 {
                reg = <1>;
                dsi_out: endpoint {
                remote-endpoint = <&mipi_in_panel>;
                };
            };
        };
    };

    i2c0 {
        #address-cells = <1>;
        #size-cells = <0>;
        status = "okay";

        waveshare: panel@45 {
            compatible = "waveshare,7.0inch-c-panel";
            reg = <0x45>;

            port {
                mipi_in_panel: endpoint {
                    remote-endpoint = <&dsi_out>;
                };
            };
        };
    };
...
```

## Documentation/devicetree/bindings/dma/microchip,mpfs-fpga-dma.yaml
```yaml
# SPDX-License-Identifier: GPL-2.0
%YAML 1.2
---
$id: http://devicetree.org/schemas/dma/microchip,mpfs-fpga-dma.yaml#
$schema: http://devicetree.org/meta-schemas/core.yaml#

title: Microchip FPGA soft DMA controller core

maintainers:
  - Conor Dooley <conor.dooley@microchip.com>

allOf:
  - $ref: dma-controller.yaml#

properties:
  "#dma-cells":
    const: 1

  compatible:
    const: microchip,mpfs-fpga-dma

  reg:
    maxItems: 1

  interrupts:
    maxItems: 1

  clocks:
    maxItems: 1

required:
  - "#dma-cells"
  - compatible
  - reg
  - interrupts

additionalProperties: false

examples:
  - |
    dma: dma-controller@60020000 {
        compatible = "microchip,mpfs-fpga-dma";
        reg = <0x60020000 0x1000>;
        interrupt-parent = <&plic>;
        interrupts = <120>;
        status = "disabled";
    };

...
```

## Documentation/devicetree/bindings/input/atmel,ptc.txt
```
Atmel PTC Subsystem

The Atmel Peripheral Touch Controller subsystem offers built-in hardware
for capacitive touch measurement on sensors that function as buttons, sliders
and wheels.

Required properties:
- compatible: 		Must be "atmel,sama5d2-ptc"
- reg: 			Address, length of the shared memory and ppp registers location
			and length.
- clocks: 		Phandlers to the clocks.
- clock-names: 		Must be "ptc_clk", "ptc_int_osc", "slow_clk".

Example:
	ptc@fc060000 {
		compatible = "atmel,sama5d2-ptc";
		reg = <0x00800000 0x10000
		       0xfc060000 0xcf>;
		interrupts = <58 IRQ_TYPE_LEVEL_HIGH 7>;
		clocks = <&ptc_clk>, <&main>, <&clk32k>;
		clock-names = "ptc_clk", "ptc_int_osc", "slow_clk";
	};
```

## Documentation/devicetree/bindings/input/raspberrypi,sensehat-joystick.yaml
```yaml
# SPDX-License-Identifier: (GPL-2.0-only OR BSD-2-Clause)
%YAML 1.2
---
$id: http://devicetree.org/schemas/input/raspberrypi,sensehat-joystick.yaml#
$schema: http://devicetree.org/meta-schemas/core.yaml#

title: Raspberry Pi Sensehat Joystick

maintainers:
  - Charles Mirabile <cmirabil@redhat.com>
  - Joel Savitz <jsavitz@redhat.com>

description:
  This device is part of the sensehat multi function device.
  For more information see ../mfd/raspberrypi,sensehat.yaml.

  This device features a five button joystick (up, down,left,
  right, click)

properties:
  compatible:
    const: raspberrypi,sensehat-joystick

  interrupts:
    maxItems: 1

required:
  - compatible
  - interrupts

additionalProperties: false
```

## Documentation/devicetree/bindings/mailbox/microchip,miv-ihc.yaml
```yaml
# SPDX-License-Identifier: (GPL-2.0-only OR BSD-2-Clause)
%YAML 1.2
---
$id: http://devicetree.org/schemas/mailbox/microchip,miv-ihc.yaml#
$schema: http://devicetree.org/meta-schemas/core.yaml#

title: Microchip PolarFire Mi-V Inter-hart communication (IHC) driver

maintainers:
  - Valentina Fernandez <valentina.fernandezalanis@microchip.com>
  - Conor Dooley <Conor Dooley <conor.dooley@microchip.com>>

description: |
  The Mi-V Inter-hart Communication (IHC) subsystem is used to exchange
  data between harts in PolarFire SoC. It provides the ability to
  send messages (ie. data, status and control) and coordinate between
  harts through a non-blocking interrupt signaling mechanism.

properties:
  compatible:
    const: microchip,miv-ihc

  interrupts:
    description: |
      Should contain the IHC interrupt associated with the lowest
      hart ID in the local software context.
    maxItems: 1

  microchip,miv-ihc-remote-context-id:
    $ref: /schemas/types.yaml#/definitions/uint32
    enum: [5, 6]
    default: 6
    description: |
      ID of the software context where data should be sent to.
      Should be either a value of 5 (Context A) or 6 (Context B).
      A default value of 6 should be used to match default IHC configuration
      (Linux on context A and RTOS/BM on context B).

  "#mbox-cells":
    const: 1

required:
  - compatible
  - interrupts
  - "#mbox-cells"
  - microchip,miv-ihc-remote-context-id

additionalProperties: false

examples:
  - |
    #include "dt-bindings/mailbox/miv-ihc.h"
    ihc: mailbox {
      compatible = "microchip,miv-ihc";
      interrupt-parent = <&plic>;
      interrupts = <IHC_HART1_INT>;
      microchip,miv-ihc-remote-context-id = <IHC_CONTEXT_B>;
      #mbox-cells = <1>;
    };
```

## Documentation/devicetree/bindings/media/microchip,fpga-dscmi.yaml
```yaml
# SPDX-License-Identifier: (GPL-2.0-only OR BSD-2-Clause)
%YAML 1.2
---
$id: http://devicetree.org/schemas/media/microchip,fpga-dscmi.yaml#
$schema: http://devicetree.org/meta-schemas/core.yaml#

title: Microchip Digital Serial Camera Memory Interface

maintainers:
  - Shravan Chippa <shravan.chippa@microchip.com>

description:
  The Digital Serial Camera Memory Interface is a fabric-based video pipeline
  used in Microchip's "Smart Embedded Vision" development kits. It captures raw
  sRGB frames from a CSI2 interface, converts them to YUV422 & can convert to a
  other formats, including H264 & MJPEG.

properties:
  compatible:
    enum:
      - microchip,fpga-dscmi
      - microchip,fpga-dscmi-rtl-v2306  # Compatible hardware to enable/disable OSD feature

  reg:
    maxItems: 1

  interrupts:
    maxItems: 1

  dmas:
    maxItems: 1

  dma-names:
    items:
      - const: rx

  reset-gpios:
    maxItems: 1
    description: CSI2 module MIPI training reset

  memory-region:
    description:
      This memory region is used for DMA transfers to/from the streaming
      interface.
    maxItems: 1

  port:
    $ref: /schemas/graph.yaml#/$defs/port-base
    unevaluatedProperties: false
    description:
      supports a single port node with CSI2 interface.

    properties:
      endpoint:
        $ref: /schemas/media/video-interfaces.yaml#
        unevaluatedProperties: false

required:
  - compatible
  - reg
  - interrupts
  - reset-gpios
  - memory-region
  - dmas
  - dma-names
  - port

additionalProperties: false

examples:
  - |
    #include <dt-bindings/gpio/gpio.h>

    mchp_dscmi_cam0: video-pipeline@40000000 {
        compatible = "microchip,fpga-dscmi";
        reg = <0x40000000 0x2000>;
        interrupt-parent = <&plic>;
        interrupts = <118>;
        reset-gpios = <&gpio2 4 GPIO_ACTIVE_HIGH>;
        memory-region = <&cambuf0>;
        dmas = <&pdma 0>;
        dma-names = "rx";
        port {
            mchp_dscmi_ep_cam0: endpoint {
                remote-endpoint = <&imx334_ep_cam0>;
               };
           };
      };

...
```
