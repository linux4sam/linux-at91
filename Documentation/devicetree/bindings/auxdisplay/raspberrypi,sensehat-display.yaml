## Documentation/devicetree/bindings/media/microchip,video-capture.yaml
```yaml
# SPDX-License-Identifier: (GPL-2.0-only OR BSD-2-Clause)
%YAML 1.2
---
$id: http://devicetree.org/schemas/media/microchip,video-capture.yaml#
$schema: http://devicetree.org/meta-schemas/core.yaml#

title: Microchip Video Capture

maintainers:
  - Shravan Chiappa  <shravan.chippa@microchip.com>

description:
  Microchip Video Capture IP processes the video streams through one or more
  video IP cores. The DT node of the video capture represents as a top level
  node of the pipeline.

properties:
  compatible:
    items:
      - enum:
          - microchip,video-dma-rtl-v0
  reg:
    maxItems: 1

  interrupts:
    maxItems: 1

  clocks:
    items:
      - description: AXI Lite clock
      - description: Video frame clock

  clock-names:
    items:
      - const: axi
      - const: video

  ports:
    $ref: /schemas/graph.yaml#/properties/ports

    properties:
      port@0:
        $ref: /schemas/graph.yaml#/$defs/port-base
        description: |
          Input / sink port node, endpoint describing modules connected video capture IP.

required:
  - compatible
  - reg
  - interrupts
  - clocks
  - clock-names
  - ports

additionalProperties: false

examples:
  - |
    video_cap0: video-cap@50020000 {
        compatible = "microchip,video-dma-rtl-v0";
        reg = <0x50020000 0x10000>;
        interrupt-parent = <&plic>;
        interrupts = <121>;
        clock-names = "axi", "video";
        clocks = <&axi_clk_0>, <&video_clk_0>;
        status = "okay";

        ports {
          #address-cells = <1>
          #size-cells = <0>;
            port@1 {
                /* Sink port */
                reg = <0>;
                video_cap_in0: endpoint {
                    remote-endpoint = <&any_in>;
                };
            };
        };
    };

...
```

## Documentation/devicetree/bindings/media/microchip,yuv2h264.yaml
```yaml
# SPDX-License-Identifier: (GPL-2.0-only OR BSD-2-Clause)
%YAML 1.2
---
$id: http://devicetree.org/schemas/media/microchip,yuv2h264.yaml#
$schema: http://devicetree.org/meta-schemas/core.yaml#

title: Microchip H.264 Encoder IP

maintainers:
  - Shravan Chippa <shravan.chippa@microchip.com>

description: |
  The Microchip H.264 encoder IP used for encode H.264 frame from
  yuv422 frames and stream the video data through AXI streaming
  or native interface to video DMA node.

properties:
  compatible:
    items:
      - enum:
          - microchip,yuv2h264-rtl-v1

  reg:
    maxItems: 1

  ports:
    $ref: /schemas/graph.yaml#/properties/ports

    properties:
      "#address-cells":
        const: 1

      "#size-cells":
        const: 0

      port@0:
        type: object
        description: The Input/sink port node properties.
        properties:
          reg:
            description: Input/sink port number.
            const: 0

          endpoint:
            type: object

            properties:
              remote-endpoint: true

            required:
              - remote-endpoint

            additionalProperties: false

        required:
          - reg
          - endpoint

        additionalProperties: false

    patternProperties:
      "port@1":
        type: object
        description: The Output/source port node properties.
        properties:
          reg:
            description: Output/source port number.

          endpoint:
            type: object

            properties:
              remote-endpoint: true

            required:
              - remote-endpoint

            additionalProperties: false

        required:
          - reg
          - endpoint

        additionalProperties: false

    required:
      - "#address-cells"
      - "#size-cells"
      - port@0
      - port@1

    additionalProperties: false

required:
  - compatible
  - reg
  - ports

additionalProperties: false

examples:
  - |
    #include <dt-bindings/media/microchip-common.h>

    yuv2h264_0: h264-video-0@50020000 {
        compatible = "microchip,yuv2h264-rtl-v1";
        reg = <0x50020000 0x10000>;

        ports {
            #address-cells = <1>;
            #size-cells = <0>;

            port@0 {
                /* Sink port */
                reg = <0>;
                h264_0_in: endpoint {
                    remote-endpoint = <&yuv420_0_out>;
                };
            };
            port@1 {
                /* Source port */
                reg = <1>;
                h264_0_out: endpoint {
                    remote-endpoint = <&video_dma_in>;
                };
            };
        };
    };
...
```

## Documentation/devicetree/bindings/media/snps,dw-csi.yaml
```yaml
# SPDX-License-Identifier: (GPL-2.0-only OR BSD-2-Clause)
%YAML 1.2
---
$id: http://devicetree.org/schemas/media/snps,dw-csi.yaml#
$schema: http://devicetree.org/meta-schemas/core.yaml#

title: Synopsys DesignWare CSI-2 Host controller (csi2host)

maintainers:
  - Eugen Hristev <eugen.hristev@microchip.com>

description:
  CSI2HOST is used to receive image coming from an MIPI CSI-2 compatible
  camera. It will convert the incoming CSI-2 stream into a dedicated
  interface called the Synopsys IDI (Image Data Interface).
  This interface is a 32-bit SoC internal only, and can be assimilated
  with a CSI-2 interface.

properties:
  compatible:
    const: snps,dw-csi

  reg:
    maxItems: 1

  clocks:
    maxItems: 2

  clock-names:
    description:
      CSI2HOST can have two clocks connected. One clock is the
      peripheral clock for the inside functionality of the hardware block.
      This is named 'perclk'. The second clock can be the phy clock,
      which is used to clock the phy via an internal link.
      This clock is named 'phyclk', phy clock.
    items:
      - const: perclk
      - const: phyclk

  phys:
    maxItems: 1
    description: MIPI D-PHY

  phy-names:
    items:
      - const: dphy

  resets:
    maxItems: 1

  interrupts:
    maxItems: 1

  ports:
    $ref: /schemas/graph.yaml#/properties/ports

    properties:
      port@0:
        $ref: /schemas/graph.yaml#/$defs/port-base
        unevaluatedProperties: false
        description:
          Input port node, single endpoint describing the input port.

        properties:
          endpoint:
            $ref: video-interfaces.yaml#
            unevaluatedProperties: false
            description: Endpoint connected to input device

            properties:
              bus-type:
                const: 4

              data-lanes:
                minItems: 1
                maxItems: 4
                items:
                  maximum: 4

              clock-lanes:
                maxItems: 1

              remote-endpoint: true

      port@1:
        $ref: /schemas/graph.yaml#/$defs/port-base
        unevaluatedProperties: false
        description:
          Output port node, single endpoint describing the output port.

        properties:
          endpoint:
            unevaluatedProperties: false
            $ref: video-interfaces.yaml#
            description: Endpoint connected to output device

            properties:
              bus-type:
                const: 4

              remote-endpoint: true

    required:
      - port@0
      - port@1

additionalProperties: false

required:
  - compatible
  - ports

examples:
  - |
    csi2: csi2@3000 {
        compatible = "snps,dw-csi";
        reg = <0x03000 0x7FF>;
        phys = <&mipi_dphy_rx>;
        phy-names = "dphy";
        resets = <&dw_rst 1>;
        interrupts = <2>;

        ports {
            #address-cells = <1>;
            #size-cells = <0>;

            port@0 {
                reg = <0>;

                csi_ep1: endpoint {
                    bus-type = <4>; /* MIPI CSI2 D-PHY */
                    remote-endpoint = <&camera_1>;
                    data-lanes = <1 2>;
                    clock-lanes = <0>;
                };
            };

            port@1 {
                reg = <1>;

                csi_ep2: endpoint {
                    remote-endpoint = <&idi_receiver>;
                    bus-type = <4>;
                };
            };
        };
    };

...
```

## Documentation/devicetree/bindings/mfd/raspberrypi,sensehat.yaml
```yaml
# SPDX-License-Identifier: (GPL-2.0-only OR BSD-2-Clause)
%YAML 1.2
---
$id: http://devicetree.org/schemas/mfd/raspberrypi,sensehat.yaml#
$schema: http://devicetree.org/meta-schemas/core.yaml#

title: Raspberry Pi Sensehat

maintainers:
  - Charles Mirabile <cmirabil@redhat.com>
  - Joel Savitz <jsavitz@redhat.com>

description:
  The Raspberry Pi Sensehat is an addon board originally developed
  for the Raspberry Pi that has a joystick and an 8x8 RGB LED display
  as well as several environmental sensors. It connects via i2c and
  a gpio for irq.

properties:
  compatible:
    const: raspberrypi,sensehat

  reg:
    maxItems: 1

  joystick:
    $ref: /schemas/input/raspberrypi,sensehat-joystick.yaml#

  display:
    $ref: /schemas/auxdisplay/raspberrypi,sensehat-display.yaml#

required:
  - compatible
  - reg
  - joystick
  - display

additionalProperties: false

examples:
  - |
    #include <dt-bindings/interrupt-controller/irq.h>
    i2c {
      #address-cells = <1>;
      #size-cells = <0>;
      hat@46 {
        compatible = "raspberrypi,sensehat";
        reg = <0x46>;
        display {
          compatible = "raspberrypi,sensehat-display";
        };
        joystick {
          compatible = "raspberrypi,sensehat-joystick";
          interrupts = <23 IRQ_TYPE_EDGE_RISING>;
        };
      };
    };
```

## Documentation/devicetree/bindings/mfd/syscon-smc.yaml
```yaml
# SPDX-License-Identifier: (GPL-2.0-only OR BSD-2-Clause)
%YAML 1.2
---
$id: http://devicetree.org/schemas/mfd/syscon-smc.yaml#
$schema: http://devicetree.org/meta-schemas/core.yaml#

title: System Controller Registers R/W via SMC Device Tree Bindings

description: |
  System controller SMC node represents a register region containing a set
  of miscellaneous registers accessed through a secure monitor.
  The typical use-case is the same as the syscon one but when running with a
  secure monitor.

maintainers:
  - Lee Jones <lee.jones@linaro.org>

properties:
  compatible:
    anyOf:
      - items:
          - enum:
              - atmel,sama5d2-sfr

          - const: syscon-smc

      - contains:
          const: syscon-smc
        minItems: 2
        maxItems: 4  # Should be enough

  arm,smc-id:
    $ref: /schemas/types.yaml#/definitions/uint32
    description: |
      The ATF smc function id used by the firmware.

  reg-io-width:
    description: |
      The size (in bytes) of the IO accesses that should be performed
      on the device.
    $ref: /schemas/types.yaml#/definitions/uint32
    enum: [1, 2, 4, 8]

required:
  - compatible
  - arm,smc-id

additionalProperties: false

examples:
  - |
    sfr {
        compatible = "atmel,sama5d2-sfr", "syscon-smc";
        arm,smc-id = <0x02000300>;
    };

...
```

## Documentation/devicetree/bindings/misc/microchip,mpfs-dma-proxy.yaml
```yaml
# SPDX-License-Identifier: (GPL-2.0 OR BSD-2-Clause)
%YAML 1.2
---
$id: http://devicetree.org/schemas/misc/microchip,mpfs-dma-proxy.yaml#
$schema: http://devicetree.org/meta-schemas/core.yaml#

title: Microchip PolarFire SoC DMA proxy

description:
  Userspace DMA interface, Exposing the platform DMA on PolarFire SoC

maintainers:
  - Shravan Chippa <shravan.chippa@microchip.com>

properties:
  compatible:
    const: microchip,mpfs-dma-proxy

  dmas:
    minItems: 1
    maxItems: 4

  dma-names:
    items:
      - const: dma-proxy0
      - const: dma-proxy1
      - const: dma-proxy2
      - const: dma-proxy3
    minItems: 1

required:
  - compatible
  - dmas
  - dma-names

additionalProperties: false

examples:
  - |

    mpfs_dma_proxy: mpfs-dma-proxy {
        compatible = "microchip,mpfs-dma-proxy";
        dmas = <&pdma 3>;
        dma-names = "dma-proxy0";
    };
```

## Documentation/devicetree/bindings/phy/microchip,sama7-usb-phy.yaml
```yaml
# SPDX-License-Identifier: (GPL-2.0 OR BSD-2-Clause)
%YAML 1.2
---
$id: http://devicetree.org/schemas/phy/microchip,sama7-usb-phy.yaml#
$schema: http://devicetree.org/meta-schemas/core.yaml#

title: Microchip SAMA7 USB PHY

maintainers:
  - Cristian Birsan <cristian.birsan@microchip.com>

properties:
  "#phy-cells":
    const: 0

  compatible:
    enum:
      - microchip,sama7g5-usb-phy

  reg:
    items:
      - description: PHY id

  clocks:
    maxItems: 1
    description: USB PHY bus clock

  clock-names:
    const: utmi_clk

  sfr-phandle:
    maxItems: 1
    description: phandle to Special Function Registers (SFR) node

required:
  - "#phy-cells"
  - compatible
  - clocks
  - clock-names
  - reg
  - sfr-phandle

additionalProperties: false

examples:
  - |
    #include <dt-bindings/clock/at91.h>

    utmi {
        #address-cells = <1>;
        #size-cells = <0>;

        usb_phy0: phy@0 {
          compatible = "microchip,sama7g5-usb-phy";
          sfr-phandle = <&sfr>;
          reg = <0>;
          clocks = <&utmi_clk UTMI1>;
          clock-names = "utmi_clk";
          status = "disabled";
          #phy-cells = <0>;
        };
    };
```

## Documentation/devicetree/bindings/phy/microchip,sama7-utmi-clk.yaml
```yaml
# SPDX-License-Identifier: (GPL-2.0 OR BSD-2-Clause)
%YAML 1.2
---
$id: http://devicetree.org/schemas/phy/microchip,sama7-utmi-clk.yaml#
$schema: http://devicetree.org/meta-schemas/core.yaml#

title: Microchip SAMA7 UTMI Clock

maintainers:
  - Cristian Birsan <cristian.birsan@microchip.com>

properties:
  "#clock-cells":
    const: 1

  compatible:
    enum:
      - microchip,sama7g5-utmi-clk

  clocks:
    maxItems: 1

  clock-names:
    maxItems: 1

  sfr-phandle:
    maxItems: 1
    description: phandle to Special Function Registers (SFR) node

  resets:
    maxItems: 3
    minItems: 3

  reset-names:
    maxItems: 3
    minItems: 3

required:
  - "#clock-cells"
  - compatible
  - sfr-phandle
  - clocks
  - clock-names
  - resets
  - reset-names

additionalProperties: false

examples:
  - |
    #include <dt-bindings/clock/at91.h>
    #include <dt-bindings/reset/sama7g5-reset.h>

    utmi_clk: utmi-clk {
      compatible = "microchip,sama7g5-utmi-clk";
      sfr-phandle = <&sfr>;
      #clock-cells = <1>;
      clocks = <&pmc PMC_TYPE_CORE PMC_UTMI>;
      clock-names = "utmi_clk";
      resets = <&reset_controller SAMA7G5_RESET_USB_PHY1>,
               <&reset_controller SAMA7G5_RESET_USB_PHY2>,
               <&reset_controller SAMA7G5_RESET_USB_PHY3>;
      reset-names = "usb0_reset", "usb1_reset", "usb2_reset";
    };
```

## Documentation/devicetree/bindings/phy/snps,dw-dphy-rx.txt
```
Synopsys DesignWare MIPI Rx D-PHY block details

Description
-----------

The Synopsys MIPI D-PHY controller supports MIPI-DPHY in receiver mode.
Please refer to phy-bindings.txt for more information.

Required properties:
- compatible		: Shall be "snps,dw-dphy-rx".
- #phy-cells		: Must be 1.
- bus-width		: Size of the test interface data bus (8 bits->8 or
			  12bits->12).
- snps,dphy-frequency	: Frequency at which D-PHY should start, configurable.
			  Check Synopsys databook. (-kHz)
- reg			: Test interface register. This correspondes to the
			  physical base address of the controller and size of
			  the device memory mapped registers; Check Synopsys
			  databook.

Example:

	mipi_dphy_rx1: dphy@d00003040 {
		compatible = "snps,dw-dphy-rx";
		#phy-cells = <1>;
		bus-width = <12>;
		snps,dphy-frequency = <300000>;
		reg = <0xd0003040 0x20>;
	};
```
