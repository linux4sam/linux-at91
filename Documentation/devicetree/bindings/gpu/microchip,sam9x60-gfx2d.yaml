## Documentation/devicetree/bindings/remoteproc/microchip,ipc-sbi-remoteproc.yaml
```yaml
# SPDX-License-Identifier: (GPL-2.0-only OR BSD-2-Clause)
%YAML 1.2
---
$id: http://devicetree.org/schemas/remoteproc/microchip,ipc-sbi-remoteproc.yaml#
$schema: http://devicetree.org/meta-schemas/core.yaml#

title: Microchip IPC Remote Processor

description:
  Microchip family of RISC-V SoCs typically have one or more
  clusters. These clusters can be configured to run in an Asymmetric
  Multi Processing (AMP) mode where clusters are split in independent
  software contexts.

maintainers:
  - Valentina Fernandez <valentina.fernandezalanis@microchip.com>

properties:
  compatible:
    const: microchip,ipc-sbi-remoteproc

  mboxes:
    description:
      Microchip IPC mailbox specifier. To be used for communication with
      a remote cluster. The specifier format is as per the bindings,
      Documentation/devicetree/bindings/mailbox/microchip,sbi-ipc.yaml
    maxItems: 1

  memory-region:
    minItems: 1
    maxItems: 5
    description:
      List of phandles to the reserved memory regions associated wih the remoteproc
      device. This is variable and describes the memories shared with the remote cluster
      (e.g. firmware, resource table, rpmsg vrings, etc.)
    items:
      anyOf:
        - description: region used for the resource table when firmware is started by the bootloader
        - description: region used for the remote cluster firmware image section
        - description: virtio device (vdev) buffer
        - description: virtqueue for sending messages to the remote cluster (vring0)
        - description: virtqueue for receiving messages from the remote cluster (vring1)


  memory-region-names:
    minItems: 1
    maxItems: 5
    items:
      anyOf:
        - const: rsc-table
        - const: firmware
        - const: buffer
        - const: vring0
        - const: vring1

required:
  - compatible
  - mboxes
  - memory-region
  - memory-region-names

additionalProperties: false


examples:
  - |
    // Early boot mode example - firmware started by bootloader
    soc {
        #address-cells = <2>;
        #size-cells = <2>;

        remoteproc {
            compatible = "microchip,ipc-sbi-remoteproc";
            mboxes= <&ihc 8>;
            memory-region = <&rsctable>, <&vdev0buffer>,
                            <&vdev0vring0>, <&vdev0vring1>;
            memory-region-names = "rsc-table", "buffer",
                                  "vring0", "vring1";
        };
    };

  - |
    // Late boot mode example - firmware started by Linux (remoteproc)
    soc {
        #address-cells = <2>;
        #size-cells = <2>;

        remoteproc {
            compatible = "microchip,ipc-sbi-remoteproc";
            mboxes= <&ihc 8>;
            memory-region = <&cluster_firmware>, <&vdev0buffer>,
                            <&vdev0vring0>, <&vdev0vring1>;
            memory-region-names = "firmware", "buffer",
                                  "vring0", "vring1";
        };
    };
...
```

## Documentation/devicetree/bindings/riscv/microchip.yaml
```yaml
# SPDX-License-Identifier: (GPL-2.0-only OR BSD-2-Clause)
%YAML 1.2
---
$id: http://devicetree.org/schemas/riscv/microchip.yaml#
$schema: http://devicetree.org/meta-schemas/core.yaml#

title: Microchip SoC-based boards

maintainers:
  - Conor Dooley <conor.dooley@microchip.com>
  - Daire McNamara <daire.mcnamara@microchip.com>

description:
  Microchip SoC-based boards

properties:
  $nodename:
    const: '/'
  compatible:
    oneOf:
      # Production Device Icicle Kits
      - items:
          - const: microchip,mpfs-icicle-prod-reference-rtl-v2507
          - const: microchip,mpfs-icicle-kit-prod
          - const: microchip,mpfs-icicle-kit
          - const: microchip,mpfs-prod
          - const: microchip,mpfs

      # Engineering Sample Icicle Kits
      - items:
          - enum:
              - microchip,mpfs-icicle-reference-rtlv2203
              - microchip,mpfs-icicle-reference-rtlv2210
              - microchip,mpfs-icicle-reference-rtl-v2406
              - microchip,mpfs-icicle-es-reference-rtl-v2507
          - const: microchip,mpfs-icicle-kit
          - const: microchip,mpfs

      - items:
          - const: microchip,mpfs-video-kit
          - const: microchip,mpfs-sev-kit
          - const: microchip,mpfs
      - items:
          - enum:
              - aldec,tysom-m-mpfs250t-rev2
              - aries,m100pfsevp
              - beagle,beaglev-fire
              - microchip,mpfs-disco-kit
              - microchip,mpfs-sev-kit
              - sundance,polarberry
          - const: microchip,mpfs
      - items:
          - const: microchip,pic64gx-curiosity-kit
          - const: microchip,pic64gx

additionalProperties: true

...
```

## Documentation/devicetree/bindings/serial/microchip,coreuart-rtl-v5.yaml
```yaml
# SPDX-License-Identifier: (GPL-2.0 OR BSD-2-Clause)
%YAML 1.2
---
$id: http://devicetree.org/schemas/serial/microchip,coreuart-rtl-v5.yaml#
$schema: http://devicetree.org/meta-schemas/core.yaml#

title: Microchip CoreUART APB Serial Controller

maintainers:
  - Prashanth Kumar Burujukindi <prashanthkumar.burujukindi@microchip.com>

description: |
  Microchip CoreUART is a soft IP for FPGA designs,
  supports configurable baud rates, parity modes, and data widths.

allOf:
  - $ref: serial.yaml#

properties:
  compatible:
    const: microchip,coreuart-rtl-v5

  reg:
    maxItems: 1

  interrupts:
    maxItems: 1

  clocks:
    maxItems: 1

required:
  - compatible
  - reg
  - interrupts
  - clocks

unevaluatedProperties: false

examples:
  - |
   #include <dt-bindings/clock/microchip,mpfs-clock.h>

   serial@40000300 {
        compatible = "microchip,coreuart-rtl-v5";
        reg = <0x40000300 0x100>;
        interrupt-parent = <&plic>;
        interrupts = <124>;
        clocks = <&ccc_nw CLK_CCC_PLL0_OUT3>;
        status = "okay";
    };
```

## Documentation/devicetree/bindings/soc/microchip/microchip,mpfs-control-scb.yaml
```yaml
# SPDX-License-Identifier: GPL-2.0-only OR BSD-2-Clause
%YAML 1.2
---
$id: http://devicetree.org/schemas/soc/microchip/microchip,microchip,mpfs-control-scb.yaml#
$schema: http://devicetree.org/meta-schemas/core.yaml#

title: Microchip PolarFire SoC Microprocessor Subsystem (MSS) control-scb register region

maintainers:
  - Conor Dooley <conor.dooley@microchip.com>

description:
  An assortment of registers that controls the temperature sensor and
  access to the system services from the MSS.

properties:
  compatible:
    oneOf:
      - items:
          - const: microchip,mpfs-control-scb
          - const: syscon
      - items:
          - const: microchip,pic64gx-control-scb
          - const: microchip,mpfs-control-scb
          - const: syscon

  reg:
    maxItems: 1

required:
  - compatible
  - reg

additionalProperties: false

examples:
  - |
    syscon@37020000 {
      compatible = "microchip,mpfs-control-scb", "syscon";
      reg = <0x0 0x37020000 0x0 0x100>;
    };

...
```

## Documentation/devicetree/bindings/soc/microchip/microchip,mpfs-mss-top-sysreg.yaml
```yaml
# SPDX-License-Identifier: GPL-2.0-only OR BSD-2-Clause
%YAML 1.2
---
$id: http://devicetree.org/schemas/soc/microchip/microchip,mpfs-mss-top-sysreg.yaml#
$schema: http://devicetree.org/meta-schemas/core.yaml#

title: Microchip PolarFire SoC Microprocessor Subsystem (MSS) sysreg register region

maintainers:
  - Conor Dooley <conor.dooley@microchip.com>

description:
  An wide assortment of registers that control elements of the MSS on PolarFire
  SoC, including pinmuxing, resets and clocks among others.

properties:
  compatible:
    oneOf:
      - items:
          - const: microchip,mpfs-mss-top-sysreg
          - const: syscon
          - const: simple-mfd
      - items:
          - const: microchip,pic64gx-mss-top-sysreg
          - const: microchip,mpfs-mss-top-sysreg
          - const: syscon
          - const: simple-mfd

  reg:
    maxItems: 1

  '#address-cells':
    const: 1

  '#size-cells':
    const: 1

  '#reset-cells':
    description:
      The AHB/AXI peripherals on the PolarFire SoC have reset support, so
      from CLK_ENVM to CLK_CFM. The reset consumer should specify the
      desired peripheral via the clock ID in its "resets" phandle cell.
      See include/dt-bindings/clock/microchip,mpfs-clock.h for the full list
      of PolarFire clock/reset IDs.
    const: 1

  interrupt-controller@54:
    type: object
    $ref: /schemas/interrupt-controller/microchip,mpfs-gpio-irq-mux.yaml

required:
  - compatible
  - reg
  - '#reset-cells'

additionalProperties: false

examples:
  - |
    soc {
      #address-cells = <1>;
      #size-cells = <1>;

      syscon@20002000 {
        compatible = "microchip,mpfs-mss-top-sysreg", "syscon", "simple-mfd";
        reg = <0x20002000 0x1000>;
        #reset-cells = <1>;
          interrupt-controller@54 {
            compatible = "microchip,mpfs-gpio-irq-mux";
            reg = <0x54 0x4>;
            interrupt-parent = <&plic>;
            interrupt-controller;
            #interrupt-cells = <1>;
            interrupts = <13>, <14>, <15>, <16>,
                         <17>, <18>, <19>, <20>,
                         <21>, <22>, <23>, <24>,
                         <25>, <26>, <27>, <28>,
                         <29>, <30>, <31>, <32>,
                         <33>, <34>, <35>, <36>,
                         <37>, <38>, <39>, <40>,
                         <41>, <42>, <43>, <44>,
                         <45>, <46>, <47>, <48>,
                         <49>, <50>, <51>, <52>,
                         <53>;
          };
       };
    };
```

## Documentation/devicetree/bindings/soc/microchip/microchip,mpfs-sysreg-scb.yaml
```yaml
# SPDX-License-Identifier: GPL-2.0-only OR BSD-2-Clause
%YAML 1.2
---
$id: http://devicetree.org/schemas/soc/microchip/microchip,microchip,mpfs-sysreg-scb.yaml#
$schema: http://devicetree.org/meta-schemas/core.yaml#

title: Microchip PolarFire SoC Microprocessor Subsystem (MSS) sysreg-scb register region

maintainers:
  - Conor Dooley <conor.dooley@microchip.com>

description:
  An wide assortment of registers, containing controls for core
  peripheral clocks and boot-time configuration knobs access mainly by
  platform firmware.

properties:
  compatible:
    oneOf:
      - items:
          - const: microchip,mpfs-sysreg-scb
          - const: syscon
      - items:
          - const: microchip,pic64gx-sysreg-scb
          - const: microchip,mpfs-sysreg-scb
          - const: syscon

  reg:
    maxItems: 1

required:
  - compatible
  - reg

additionalProperties: false

examples:
  - |
    syscon@20003000 {
      compatible = "microchip,mpfs-sysreg-scb", "syscon";
      reg = <0x0 0x20003000 0x0 0x1000>;
    };
...
```
