## drivers/nvmem/layouts/Kconfig
```kconfig
# SPDX-License-Identifier: GPL-2.0

config NVMEM_LAYOUTS
	bool
	depends on OF

if NVMEM_LAYOUTS

menu "Layout Types"

config NVMEM_LAYOUT_SL28_VPD
	tristate "Kontron sl28 VPD layout support"
	select CRC8
	help
	  Say Y here if you want to support the VPD layout of the Kontron
	  SMARC-sAL28 boards.

	  If unsure, say N.

config NVMEM_LAYOUT_ONIE_TLV
	tristate "ONIE tlv support"
	select CRC32
	help
	  Say Y here if you want to support the Open Compute Project ONIE
	  Type-Length-Value standard table.

	  If unsure, say N.

config NVMEM_LAYOUT_SST26VF_SFDP_EUI
	tristate "Microchip/SST SFDP EUI-48 layout support"
	help
	  Say Y here if you want to expose the factory-programmed EUI-48
	  identifier stored in the Microchip/SST vendor-specific SFDP parameter
	  table (e.g. SST26VF064BEUI) as NVMEM cells, so that network drivers
	  can use them as a MAC address.

	  If unsure, say N.

config NVMEM_LAYOUT_U_BOOT_ENV
	tristate "U-Boot environment variables layout"
	select CRC32
	select GENERIC_NET_UTILS
	help
	  U-Boot stores its setup as environment variables. This driver adds
	  support for verifying & exporting such data. It also exposes variables
	  as NVMEM cells so they can be referenced by other drivers.

	  If unsure, say N.

endmenu

endif
```

## drivers/soc/microchip/Kconfig
```kconfig
config POLARFIRE_SOC_SYS_CTRL
	tristate "Microchip PolarFire SoC (MPFS) system controller support"
	depends on POLARFIRE_SOC_MAILBOX
	depends on MTD
	help
	  This driver adds support for the PolarFire SoC (MPFS) system controller.

	  To compile this driver as a module, choose M here. the
	  module will be called mpfs_system_controller.

	  If unsure, say N.

config POLARFIRE_SOC_GENERIC_SERVICE
	tristate "PFSOC FPGA generic system services"
	depends on POLARFIRE_SOC_SYS_CTRL
	help
	  The PolarFire SoC system controller is communicated with via a mailbox.
	  This driver implemtents the services provided by the system controller
	  which do not belong in a specific subsystem, such as reading the fpga
	  device certificate, all of which follow the same format:
	    - a command + optional payload sent to the sys controller
	    - a status + a payload returned to Linux

	  To compile this driver as a module, choose M here. the
	  module will be called mpfs_generic_service.

	  If unsure, say N.

config POLARFIRE_SOC_SYSCONS
	bool "PolarFire SoC (MPFS) syscon drivers"
	default y
	depends on ARCH_MICROCHIP
	select MFD_CORE
	help
	  These drivers add support for the syscons on PolarFire SoC (MPFS).
	  Without these drivers core parts of the kernel such as clocks
	  and resets will not function correctly.

	  If unsure, and on a PolarFire SoC, say y.
```
