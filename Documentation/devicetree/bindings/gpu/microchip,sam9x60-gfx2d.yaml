## Documentation/devicetree/bindings/iio/adc/microchip,pac1944.yaml
```yaml
# SPDX-License-Identifier: (GPL-2.0 OR BSD-2-Clause)
%YAML 1.2
---
$id: http://devicetree.org/schemas/iio/adc/microchip,pac1944.yaml#
$schema: http://devicetree.org/meta-schemas/core.yaml#

title: Microchip PAC1944 and PAC1954 Power Monitors with Accumulator

maintainers:
  - Marius Cristea <marius.cristea@microchip.com>

description: |
  This device is part of the Microchip family of Power Monitors with
  Accumulator. The datasheet for PAC1941-1, PAC1941-2, PAC1942-1, PAC1942-2,
  PAC1943-1 and PAC1944-1 can be found here:
    https://ww1.microchip.com/downloads/aemDocuments/documents/MSLD/ProductDocuments/DataSheets/PAC194X-Family-Data-Sheet-DS20006543.pdf
  The datasheet for PAC1951-1, PAC1951-2, PAC1952-1, PAC1952-2, PAC1953-1 and
  PAC1954-1 can be found here:
    https://ww1.microchip.com/downloads/aemDocuments/documents/MSLD/ProductDocuments/DataSheets/PAC195X-Family-Data-Sheet-DS20006539.pdf

properties:
  compatible:
    enum:
      - microchip,pac1941
      - microchip,pac1941-2
      - microchip,pac1942
      - microchip,pac1942-2
      - microchip,pac1943
      - microchip,pac1944
      - microchip,pac1951
      - microchip,pac1951-2
      - microchip,pac1952
      - microchip,pac1952-2
      - microchip,pac1953
      - microchip,pac1954

  reg:
    maxItems: 1

  vdd-supply: true

  "#address-cells":
    const: 1

  "#size-cells":
    const: 0

  interrupts:
    minItems: 1
    items:
      - description: |
          alert1: This signal is the output of the digital comparators that allow
          the user to detect over/undervoltage, over/undercurrent and overpower
          against user programmed limits for each channel and generate an alert
          when the threshold is exceeded. The limits must be enabled and routed to
          ALERT1 pin for any of the channels that will be using them.
      - description: |
          alert2: This signal is the output of the digital comparators that allow
          the user to detect over/undervoltage, over/undercurrent and overpower
          against user programmed limits for each channel and generate an ALERT
          when the threshold is exceeded. The limits must be enabled and routed to
          ALERT2 pin for any of the channels that will be using them.

  interrupt-names:
    items:
      enum: [alert1, alert2]
    minItems: 1
    maxItems: 2

  gpio-controller: true

  "#gpio-cells":
    const: 2
    description: |
      The first cell is the GPIO number: 0 to 1.
      The second cell takes standard GPIO flags.

  powerdown-gpios:
    description: |
      A GPIO used to trigger a change in sampling rate (lowering the chip power
      consumption). Active-low puts the device in a Power-Down state (all
      circuitry is powered down, including SMBus). It should be marked
      GPIO_ACTIVE_LOW.
    maxItems: 1

  slow-gpios:
    description: |
      SLOW Input pin. If this pin is forced high, the sampling rate is forced to
      8 SPS. When it is forced low, the sampling rate is 1024 SPS, unless a
      different sample rate has been programmed. The pin may be programmed to
      function as the ALERT1 pin or GPIO (open-drain). It should be marked
      GPIO_ACTIVE_HIGH.
    maxItems: 1

patternProperties:
  "^channel@[1-4]$":
    type: object
    $ref: /schemas/iio/adc/adc.yaml#
    description:
      Represents the external channels which are connected to the ADC.

    properties:
      reg:
        minimum: 1
        maximum: 4

      shunt-resistor-micro-ohms:
        description:
          Value in micro Ohms of the shunt resistor connected between
          the SENSE+ and SENSE- inputs, across which the current is measured.
          Value is needed to compute the scaling of the measured current.

      microchip,vbus-input-range-microvolt:
        description: |
          In order to increase measurement resolution and keeping the same
          number of bits the device has a configurable VBUS full range scale
          (FSR). The range should be set by hardware design and it should not be
          changed during runtime. The bipolar capability for VBUS enables
          accurate offset measurement and correction.
          The VBUS could be configured into the following full scale range:
            - VBUS has unipolar 0V to 32V FSR (default) for PAC195X or 0V to 9V
              (default) for PAC194X.
            - VBUS has bipolar -32V to 32V FSR for PAC195X or -9V to 9V for
              PAC194X. The actual range is limited to about -200 mV due to the
              impact of the ESD structures.
            - VBUS has bipolar -16V to 16V FSR for PAC195X or -4.5V to 4.5V for
              PAC194X. The actual range is limited to about -200 mV due to the
              impact of the ESD structures.
        items:
          - enum: [-32000000, -16000000, -9000000, -4500000, 0]
          - enum: [4500000, 9000000, 16000000, 32000000]

      microchip,vsense-input-range-microvolt:
        description: |
          In order to decrease the power dissipation on the shunt resistor and
          in the same time to increase measurement resolution by keeping the
          same number of bits the device has a configurable VSENSE full
          range scale (FSR). The range should be set by hardware design and it
          should not be changed during runtime.
          The VSENSE could be configured into the following full scale range:
            - VSENSE has unipolar 0V to 100 mV FSR (default)
            - VSENSE has bipolar -100 mV to 100 mV FSR
            - VSENSE has bipolar -50 mV to 50 mV FSR
        oneOf:
          - items:
              - const: 0
              - const: 100000
          - items:
              - const: -50000
              - const: 50000
          - items:
              - const: -100000
              - const: 100000

      microchip,accumulation-mode:
        $ref: /schemas/types.yaml#/definitions/uint32
        description:
          The Hardware Accumulator may be used to accumulate VPOWER, VSENSE or
          VBUS values for any channel. By setting the accumulator for a channel
          to accumulate the VPOWER values gives a measure of accumulated power
          into a time period, which is equivalent to energy. Setting the
          accumulator for a channel to accumulate VSENSE values gives a measure
          of accumulated current, which is equivalent to charge. This allows the
          accumulator to be used as a coulomb counter. For either VSENSE or
          VBUS, many samples may be accumulated on chip and the result collected
          by the host and divided by the accumulator counter count value to
          yield an average value with a very long integration time to reduce
          noise. This feature is also very useful for system calibration,
          allowing many averages to be accumulated for fast averaging/noise
          reduction.
          This functionality needs to be setup once and must not be changed
          during the runtime, just in case the user wants to measure the charge
          or the energy consumed from board power up till the user has control
          or during a reboot of the system.
          The Hardware Accumulator could be configured to accumulate
          VPOWER, VSENSE or VBUS
            0  -  Accumulator accumulates VPOWER (default)
            1  -  Accumulator accumulates VSENSE
            2  -  Accumulator accumulates VBUS
        maximum: 2
        default: 0

    required:
      - reg
      - shunt-resistor-micro-ohms

    unevaluatedProperties: false

required:
  - compatible
  - reg
  - vdd-supply
  - "#address-cells"
  - "#size-cells"

allOf:
  - if:
      properties:
        compatible:
          pattern: "^microchip,pac194"
    then:
      patternProperties:
        "^channel@[1-4]$":
          properties:
            microchip,vbus-input-range-microvolt:
              oneOf:
                - items:
                    - const: 0
                    - const: 9000000
                - items:
                    - const: -9000000
                    - const: 9000000
                - items:
                    - const: -4500000
                    - const: 4500000
              default:
                - 0
                - 9000000
  - if:
      properties:
        compatible:
          pattern: "^microchip,pac195"
    then:
      patternProperties:
        "^channel@[1-4]$":
          properties:
            microchip,vbus-input-range-microvolt:
              oneOf:
                - items:
                    - const: 0
                    - const: 32000000
                - items:
                    - const: -32000000
                    - const: 32000000
                - items:
                    - const: -16000000
                    - const: 16000000
              default:
                - 0
                - 32000000
  - if:
      properties:
        compatible:
          pattern: "^microchip,pac19[45]1"
    then:
      patternProperties:
        "^channel@[2-4]$": false
  - if:
      properties:
        compatible:
          pattern: "^microchip,pac19[45]2"
    then:
      patternProperties:
        "^channel@[3-4]$": false
  - if:
      properties:
        compatible:
          pattern: "^microchip,pac19[45]3"
    then:
      properties:
        "channel@4": false
  - if:
      required:
        - slow-gpios
    then:
      properties:
        interrupts:
          maxItems: 1
        interrupt-names:
          items:
            - const: alert2

unevaluatedProperties: false

examples:
  - |
    i2c {
        #address-cells = <1>;
        #size-cells = <0>;
        power-monitor@10 {
            compatible = "microchip,pac1954";
            reg = <0x10>;
            vdd-supply = <&vdd>;
            #address-cells = <1>;
            #size-cells = <0>;
            channel@1 {
                reg = <0x1>;
                shunt-resistor-micro-ohms = <24900>;
                label = "CPU";
                microchip,vbus-input-range-microvolt = <0 32000000>;
                microchip,vsense-input-range-microvolt = <(-50000) 50000>;
            };
            channel@3 {
                reg = <0x3>;
                shunt-resistor-micro-ohms = <75000>;
                label = "MEM";
                microchip,vbus-input-range-microvolt = <(-16000000) 16000000>;
                microchip,vsense-input-range-microvolt = <0 100000>;
            };
            channel@4 {
                reg = <0x4>;
                shunt-resistor-micro-ohms = <100000>;
                label = "NET";
                microchip,vbus-input-range-microvolt = <(-32000000) 32000000>;
                microchip,vsense-input-range-microvolt = <(-100000) 100000>;
            };
        };
    };
...
```

## Documentation/devicetree/bindings/interrupt-controller/microchip,mpfs-gpio-irq-mux.yaml
```yaml
# SPDX-License-Identifier: (GPL-2.0-only OR BSD-2-Clause)
%YAML 1.2
---
$id: http://devicetree.org/schemas/interrupt-controller/microchip,mpfs-gpio-irq-mux.yaml#
$schema: http://devicetree.org/meta-schemas/core.yaml#

title: Microchip Polarfire SoC GPIO Interrupt Mux

maintainers:
  - Conor Dooley <conor.dooley@microchip.com>

description: |
  There are 3 GPIO controllers on this SoC, of which:
  - GPIO controller 0 has 14 GPIOs
  - GPIO controller 1 has 24 GPIOs
  - GPIO controller 2 has 32 GPIOs

  All GPIOs are capable of generating interrupts, for a total of 70.
  There are only 41 IRQs available however, so a configurable mux is used to
  ensure all GPIOs can be used for interrupt generation.
  38 of the 41 interrupts are in what the documentation calls "direct mode",
  as they provide an exclusive connection from a GPIO to the PLIC.
  The 3 remaining interrupts are used to mux the interrupts which do not have
  a exclusive connection, one for each GPIO controller.

properties:
  compatible:
    oneOf:
      - const: microchip,mpfs-gpio-irq-mux
      - items:
          - const: microchip,pic64gx-gpio-irq-mux
          - const: microchip,mpfs-gpio-irq-mux

  reg:
    maxItems: 1

  interrupt-controller: true

  "#interrupt-cells":
    const: 1

  interrupts:
    description:
      The first 38 entries must be the "direct" interrupts, for exclusive
      connections to the PLIC. The final 3 entries must be the
      "non-direct"/muxed connections for each of GPIO controller 0, 1 & 2
      respectively.
    maxItems: 41

allOf:
  - $ref: /schemas/interrupt-controller.yaml#

required:
  - compatible
  - reg
  - interrupts
  - "#interrupt-cells"
  - interrupt-controller

additionalProperties: false

examples:
  - |
    interrupt-controller@54 {
        compatible = "microchip,mpfs-gpio-irq-mux";
        reg = <0x54 0x4>;
        interrupt-parent = <&plic>;
        interrupt-controller;
        #interrupt-cells = <1>;
        interrupts = <13>, <14>, <15>, <16>,
                     <17>, <18>, <19>, <20>,
                     <21>, <22>, <23>, <24>,
                     <25>, <26>, <27>, <28>,
                     <29>, <30>, <31>, <32>,
                     <33>, <34>, <35>, <36>,
                     <37>, <38>, <39>, <40>,
                     <41>, <42>, <43>, <44>,
                     <45>, <46>, <47>, <48>,
                     <49>, <50>, <51>, <52>,
                     <53>;
    };
...
```
