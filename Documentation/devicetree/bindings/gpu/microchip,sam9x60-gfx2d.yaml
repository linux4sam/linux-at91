## Documentation/devicetree/bindings/media/microchip,bayer-interpolation-rtl-v4.8.yaml
```yaml
# SPDX-License-Identifier: (GPL-2.0-only OR BSD-2-Clause)
%YAML 1.2
---
$id: http://devicetree.org/schemas/media/microchip,bayer-interpolation-rtl-v4.8.yaml#
$schema: http://devicetree.org/meta-schemas/core.yaml#

title: Microchip bayer interpolation

maintainers:
  - Shravan Chippa <shravan.chippa@microchip.com>

description: |
  The Microchip video bayer interpolation IP is used to convert the video from
  bayer to RGB video and stream the video data through AXI streaming
  interface or native interface for the image processing.

properties:
  compatible:
    oneOf:
      - items:
          - const: microchip,pic64gx-bayer-interpolation
          - const: microchip,bayer-interpolation-rtl-v4.8
      - const: microchip,bayer-interpolation-rtl-v4.8

  reg:
    maxItems: 1

  ports:
    $ref: /schemas/graph.yaml#/properties/ports

    properties:
      "#address-cells":
        const: 1

      "#size-cells":
        const: 0

      port@0:
        type: object
        description: The Input/sink port node properties.
        properties:
          reg:
            description: Input/sink port number.
            const: 0

          endpoint:
            type: object

            properties:
              remote-endpoint: true

            required:
              - remote-endpoint

            additionalProperties: false

        required:
          - reg
          - endpoint

        additionalProperties: false

    patternProperties:
      "port@1":
        type: object
        description: The Output/source port node properties.
        properties:
          reg:
            description: Output/source port number.

          endpoint:
            type: object

            properties:
              remote-endpoint: true

            required:
              - remote-endpoint

            additionalProperties: false

        required:
          - reg
          - endpoint

        additionalProperties: false

    required:
      - "#address-cells"
      - "#size-cells"
      - port@0
      - port@1

    additionalProperties: false

required:
  - compatible
  - reg
  - ports

additionalProperties: false

examples:
  - |
    demosaic-0@50020000 {
        compatible = "microchip,bayer-interpolation-rtl-v4.8";
        reg = <0x60080000 0x10000>;

        ports {
            #address-cells = <1>;
            #size-cells = <0>;

            port@0 {
                /* Sink port */
                reg = <0>;
                demosaic_0_in: endpoint {
                    remote-endpoint = <&mipi_csi2_0_in>;
                };
            };
            port@1 {
                /* Source port */
                reg = <1>;
                demosaic_0_out: endpoint {
                    remote-endpoint = <&image_enhancement_0_out>;
                };
            };
        };
    };
...
```

## Documentation/devicetree/bindings/microchip,mpfs-wdt.yaml
```yaml
# SPDX-License-Identifier: GPL-2.0-only OR BSD-2-Clause
%YAML 1.2
---
$id: http://devicetree.org/schemas/watchdog/microchip,mpfs-wdt.yaml#
$schema: http://devicetree.org/meta-schemas/core.yaml#

title: Microchip PolarFire SoC Watchdog Timer

allOf:
  - $ref: "watchdog.yaml#"

maintainers:
  - Daire McNamara <daire.mcnamara@microchip.com>

properties:
  compatible:
      const: microchip,mpfs-wdt

  reg:
    maxItems: 1

  clocks:
    maxItems: 1
    items:
      - description: The MPFS watchdog uses a 24-bit counter that counts every 256 PCLK cycles,
                     providing a maximum watchdog refresh rate of 13.74 seconds (assuming a
                     312.5 MHz APB clock rate), 14.32 seconds (assuming a 300 MHz ABP clock rate),
                     or 28.63 seconds (assuming a 150 MHz ABP clock rate).

  interrupts:
    maxItems: 2
    items:
      - description: an mvrp interrupt indicates that the watchdog is in the period between its
                     mvrp counter and its trig counter.  This indicates the watchdog can be
                     serviced in this period.
      - description: a trig interrupt indicates that the watchdog is in the period between its
                     trig counter (a maximum of 2^11 - 1 ticks) and 0.  The watchdog cannot be stopped
                     but any emergency actions can be triggered by handling this interrupt.

  interrupt-names:
    maxItems: 2
    items:
      - const: mvrp
      - const: trig

required:
  - compatible
  - reg
  - clocks
  - interrupts
  - interrupt-names

unevaluatedProperties: false

examples:
  - |
    watchdog@20001000 {
        compatible = "microchip,mpfs-wdt";
        reg = <0x20001000 0x1000>;
        interrupts = <100>, <105>;
        clocks = <&pclk>;
    };

...
```

## Documentation/devicetree/bindings/net/can/microchip,sama5d2-usart-lin.yaml
```yaml
# SPDX-License-Identifier: (GPL-2.0-only OR BSD-2-Clause)
%YAML 1.2
---
$id: http://devicetree.org/schemas/net/can/microchip,sama5d2-usart-lin.yaml#
$schema: http://devicetree.org/meta-schemas/core.yaml#

title: Microchip USART LIN controller

maintainers:
  - Balakrishnan Sambath <balakrishnan.s@microchip.com>

description:
  The LIN controller in the Microchip/Atmel FLEXCOM USART, exposed as a CAN/LIN
  network device. Break, sync, identifier parity and checksum are offloaded to
  hardware.

properties:
  compatible:
    oneOf:
      - items:
          - enum:
              - microchip,sam9x60-usart-lin
              - microchip,sam9x7-usart-lin
              - microchip,sama7g5-usart-lin
              - microchip,sama7d65-usart-lin
          - const: microchip,sama5d2-usart-lin
      - const: microchip,sama5d2-usart-lin

  reg:
    maxItems: 1

  interrupts:
    maxItems: 1

  clocks:
    maxItems: 1

  lin-responder:
    type: boolean
    description:
      The LIN role is fixed by how the board is wired. Present when the node
      is wired as a LIN responder (client). Without it the controller is a
      LIN commander (host).

required:
  - compatible
  - reg
  - interrupts
  - clocks

additionalProperties: false

examples:
  - |
    #include <dt-bindings/clock/at91.h>
    #include <dt-bindings/interrupt-controller/arm-gic.h>

    serial@200 {
        compatible = "microchip,sama7g5-usart-lin", "microchip,sama5d2-usart-lin";
        reg = <0x200 0x200>;
        interrupts = <GIC_SPI 38 IRQ_TYPE_LEVEL_HIGH>;
        clocks = <&pmc PMC_TYPE_PERIPHERAL 38>;
        lin-responder;
    };
```

## Documentation/devicetree/bindings/net/microchip,core1588-rtl-v3.yaml
```yaml
# SPDX-License-Identifier: (GPL-2.0-only OR BSD-2-Clause)
%YAML 1.2
---
$id: http://devicetree.org/schemas/net/microchip,core1588-rtl-v3.yaml#
$schema: http://devicetree.org/meta-schemas/core.yaml#

title: Microchip Core1588 PTP (Timestamping).

description: |
  Microchip core1588 PTP provides  precision timing functionality
  along with capability for time and fine adjustment. This IP is provided
  for use with Microchip CoreTSE(Triple Speed Ethernet) MAC with HW
  timestamping capability.

maintainers:
  - Praveen Kumar Vattipalli <praveen.kumar@micorchip.com>

properties:
  compatible:
    enum:
      - microchip,core1588-rtl-v3

  reg:
    description:
      Address and length of the IO space.
    maxItems: 1

  clocks:
    items:
      - description: Clock for Timestamping unit.

  clock-names:
    items:
      - const: tsu

required:
  - compatible
  - reg
  - clocks
  - clock-names

additionalProperties: false

examples:
  - |
    PTP@40002000 {
        compatible = "microchip,core1588-rtl-v3";
        reg = <0x40002000 0x1000>;
        clock-names = "tsu";
        clocks = <&ptpclk>;
        status = "okay";
    };
```

## Documentation/devicetree/bindings/net/microchip,coretse-rtl-v3.yaml
```yaml
# SPDX-License-Identifier: (GPL-2.0-only OR BSD-2-Clause)
%YAML 1.2
---
$id: http://devicetree.org/schemas/net/microchip,coretse-rtl-v3.yaml#
$schema: http://devicetree.org/meta-schemas/core.yaml#

title: Microchip CoreTSE triple speed MAC Ethernet

description: |
  The CoreTSE Native IP is an Ethernet Media Access Controller (MAC) IP,
  with a Gigabit Media Independent Interface (G/MII) or Serial Gigabit
  Media Independent Interface (SGMII) Ten Bit Interface (TBI) to support
  1000BASE-T and 1000BASE-X, along with a triple speed MAC core, supporting
  data rates up to 1Gbps.

  Management configuration is done through the AXI4LITE interface, while payload is
  sent and received through means of an CoreAXI4ProtoConv DMA IP.

maintainers:
  - Praveen Kumar Vattipalli <praveen.kumar@micorchip.com>


allOf:
  - $ref: /schemas/net/ethernet-controller.yaml#

properties:
  compatible:
    enum:
      - microchip,coretse-rtl-v3

  reg:
    description:
      Address and length of the IO space.
    maxItems: 1

  interrupts:
    items:
      - description: Tx DMA interrupt
      - description: Rx DMA interrupt

  interrupt-names:
    items:
      - const: mm2s_pcdma
      - const: s2mm_pcdma

  phy-mode:
    enum:
      - sgmii

  clocks:
    items:
      - description: Clock for AXI register slave interface.
      - description: AXI4-Stream CoreAXI4ProtoConv clock.

  clock-names:
    items:
      - const: pclk
      - const: pcdma

  pcdma-connected:
    $ref: /schemas/types.yaml#/definitions/phandle
    description: Phandle of CoreAXI4ProtoConv DMA controller which contains
      the resources used by this device. The DMA-related resources
      from that device (DMA registers and DMA TX/RX interrupts) are used.

  pcs-handle:
    description: Phandle to the PCS/PMA PHY in SGMII mode,
      where "pcs-handle" should be used to point to the PCS/PMA PHY,
      and "phy-handle" should point to an external PHY if exists.
    maxItems: 1

  microchip,core1588-ptp-handle:
    $ref: /schemas/types.yaml#/definitions/phandle
    description:
      Phandle to indicate the microchip core1588 PTP device node to
      read PTP clock index(/dev/ptp0 etc). This property is for CoreTSE.

  '#address-cells':
    const: 1

  '#size-cells':
    const: 0

patternProperties:
  "^ethernet-phy@[0-9a-f]$":
    type: object
    $ref: ethernet-phy.yaml#
    unevaluatedProperties: false

required:
  - compatible
  - interrupts
  - interrupt-names
  - reg
  - pcs-handle
  - clocks
  - clock-names
  - pcdma-connected

unevaluatedProperties: false

examples:
  - |
    ethernet@40001000 {
      compatible = "microchip,coretse-rtl-v3";
      reg = <0x40001000 0x1000>;
      interrupts = <128>, <130>;
      interrupt-parent = <&plic>;
      pcdma-connected = <&pcdma>;
      interrupt-names = "mm2s_pcdma", "s2mm_pcdma";
      clock-names = "pclk", "pcdma";
      clocks = <&clkcfg 30>, <&clkcfg 27>;
      status = "okay";
      phy-mode = "sgmii";
      pcs-handle = <&phy2>;
    };
```

## Documentation/devicetree/bindings/net/microchip,coretsn-rtl-v2.yaml
```yaml
# SPDX-License-Identifier: (GPL-2.0-only OR BSD-2-Clause)
%YAML 1.2
---
$id: http://devicetree.org/schemas/net/microchip,coretsn-rtl-v2.yaml#
$schema: http://devicetree.org/meta-schemas/core.yaml#

title: Microchip Time Sensitive Network Device

description: |
  The Microchip CoreTSN IP implements the following
  Time Sensitive Networking protocols for Ethernet.
  Traffic Shaping (IEEE 802.1Qbv)
  Frame Preemption (IEEE 802.3br and IEEE 802.1Qbu)
  Stream Filtering and Policing (IEEE 802.1Qci)

maintainers:
  - Pallela Venkat Karthik <pallela.karthik@microchip.com>

properties:
  compatible:
    enum:
      - microchip,coretsn-rtl-v2

  reg:
    description:
      Address and length of the IO space.
    maxItems: 1

  clocks:
    items:
      - description: Clock for AXI register slave interface.
      - description: Clock for CoreTSN IP.

  clock-names:
    items:
      - const: apb
      - const: core

required:
  - compatible
  - clocks
  - clock-names

additionalProperties: false

examples:
  - |
    tsn@40000000 {
        compatible = "microchip,coretsn-rtl-v2";
        reg = <0x40000000 0x1000>;
        clocks = <&clkcfg 30>, <&tsnclk>;
        clock-names = "apb", "core";
    };
```

## Documentation/devicetree/bindings/nvmem/layouts/microchip,sst26vf-sfdp-eui.yaml
```yaml
# SPDX-License-Identifier: (GPL-2.0 OR BSD-2-Clause)
%YAML 1.2
---
$id: http://devicetree.org/schemas/nvmem/layouts/microchip,sst26vf-sfdp-eui.yaml#
$schema: http://devicetree.org/meta-schemas/core.yaml#

title: NVMEM layout of the Microchip/SST SFDP EUI-48 identifier

maintainers:
  - Manikandan Muralidharan <manikandan.m@microchip.com>

description:
  Some Microchip/SST serial flashes (for example the SST26VF064BEUI) are
  factory programmed with a globally unique EUI-48 identifier stored in a
  vendor-specific SFDP parameter table and permanently write-protected. This
  layout locates that table and exposes the EUI-48 as an NVMEM cell so that,
  for example, a network driver can use it as a MAC address. The location of
  the data is discovered at runtime from the SFDP; no offset is encoded in the
  device tree.

select: false

properties:
  compatible:
    const: microchip,sst26vf-sfdp-eui

  mac-address:
    type: object
    description:
      The factory-programmed EUI-48 identifier, usable as a MAC address.
    additionalProperties: false

required:
  - compatible

additionalProperties: false

examples:
  - |
    spi {
        #address-cells = <1>;
        #size-cells = <0>;

        flash@0 {
            compatible = "jedec,spi-nor";
            reg = <0>;

            sfdp {
                compatible = "jedec,sfdp";

                nvmem-layout {
                    compatible = "microchip,sst26vf-sfdp-eui";

                    mac-address {
                    };
                };
            };
        };
    };
...
```
