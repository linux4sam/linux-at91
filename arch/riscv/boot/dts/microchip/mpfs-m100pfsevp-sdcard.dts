// SPDX-License-Identifier: GPL-2.0
/*
 * Original all-in-one devicetree:
 * Copyright (C) 2021-2023 - Wolfgang Grandegger <wg@aries-embedded.de>
 * Rewritten to use includes:
 * Copyright (C) 2022 - Conor Dooley <conor.dooley@microchip.com>
 */
/dts-v1/;

#include "mpfs-m100pfsevp.dtsi"

/* Clock frequency (in Hz) of the rtcclk */
#define MTIMER_FREQ	1000000

&gpio0 {
	/* Set to low for eMMC, high for SD-card */
	mmc-sel-hog {
		gpio-hog;
		gpios = <12 0>;
		output-high;
	};
};

&mmc {
	max-frequency = <50000000>;
	bus-width = <4>;
	cap-sd-highspeed;
	no-1-8-v;
	sd-uhs-sdr12;
	sd-uhs-sdr25;
	sd-uhs-sdr50;
	sd-uhs-sdr104;
	disable-wp;
	status = "okay";
};
